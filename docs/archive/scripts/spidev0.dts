/dts-v1/;
/plugin/;

/ {
    compatible = "brcm,bcm2835";

    fragment@0 {
        target = <&spi0>;
        __overlay__ {
            status = "okay";
            spidev@0 {
                compatible = "spidev";
                reg = <0 0 0>;
                spi-max-frequency = <32000000>;
                #address-cells = <1>;
                #size-cells = <0>;
            };
        };
    };
};
