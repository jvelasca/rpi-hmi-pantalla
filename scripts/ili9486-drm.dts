/dts-v1/;
/plugin/;

/ {
    compatible = "brcm,bcm2835";

    fragment@0 {
        target = <&spi0>;
        __overlay__ {
            status = "okay";

            display@0 {
                compatible = "waveshare,rpi-lcd-35";
                reg = <0>;
                spi-max-frequency = <32000000>;
                dc-gpios = <&gpio 24 0>;
                reset-gpios = <&gpio 17 1>;
                rotation = <270>;
            };
        };
    };
};
